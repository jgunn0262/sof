## src/arch/xtensa/configs/hikey_defconfig
```kconfig
CONFIG_HIKEY=y
CONFIG_COMP_KPB=n
CONFIG_COMP_FIR=n
CONFIG_COMP_IIR=n
CONFIG_COMP_SRC=n
CONFIG_COMP_TONE=n
CONFIG_COMP_MIXER=n
CONFIG_COMP_MUX=n
CONFIG_COMP_SWITCH=n
CONFIG_COMP_SEL=n
CONFIG_COMP_VOLUME=n
```
